## west.yml
```yaml
manifest:
  defaults:
    remote: upstream
    
  remotes:
    - name: upstream
      url-base: github.com/xmos-jmccarthy
      
  self:
      path: examples_foo
      
  projects:
    - name: mainline
      url: git@github.com:xmos-jmccarthy/test_west.git
      import:
        path-prefix: modules/foobar0
```
